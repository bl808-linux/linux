## Documentation/devicetree/bindings/clock/bflb,bl808-clock.yaml
```yaml
# SPDX-License-Identifier: (GPL-2.0-only OR BSD-2-Clause)
%YAML 1.2
---
$id: http://devicetree.org/schemas/clock/bflb,bl808-clock.yaml#
$schema: http://devicetree.org/meta-schemas/core.yaml#

title: Bouffalo Lab BL808 firmware PLL and multimedia clocks

maintainers:
  - Kwanghoon Son <asdfkwang@gmail.com>

description: |
  Firmware owns and configures the shared PLL roots. Linux reads their
  configuration without retuning or gating them. The GLB multimedia muxes
  select divided PLL outputs. MM_GLB provides the multimedia peripheral
  bus and UART clocks, and the UART and multimedia DMA resets.

properties:
  compatible:
    enum:
      - bflb,bl808-cpu-pll
      - bflb,bl808-wifi-pll
      - bflb,bl808-audio-pll
      - bflb,bl808-mm-pll-mux
      - bflb,bl808-mm-clock
  reg:
    maxItems: 1
  clocks:
    minItems: 2
    maxItems: 4
  clock-names:
    minItems: 2
    maxItems: 4
  '#clock-cells':
    enum: [0, 1]
  '#reset-cells':
    const: 1

required:
  - compatible
  - reg
  - clocks
  - clock-names
  - '#clock-cells'

allOf:
  - if:
      properties:
        compatible:
          enum:
            - bflb,bl808-cpu-pll
            - bflb,bl808-wifi-pll
            - bflb,bl808-audio-pll
    then:
      properties:
        clocks:
          maxItems: 2
        clock-names:
          items:
            - const: xtal
            - const: rc32m
        '#clock-cells':
          const: 0
        '#reset-cells': false
  - if:
      properties:
        compatible:
          const: bflb,bl808-mm-pll-mux
    then:
      properties:
        clocks:
          minItems: 3
          maxItems: 3
        clock-names:
          items:
            - const: wifi
            - const: cpu
            - const: audio
        '#clock-cells':
          const: 1
        '#reset-cells': false
  - if:
      properties:
        compatible:
          const: bflb,bl808-mm-clock
    then:
      properties:
        clocks:
          minItems: 4
        clock-names:
          items:
            - const: xtal
            - const: rc32m
            - const: pll160
            - const: pll240
        '#clock-cells':
          const: 1
      required:
        - '#reset-cells'

additionalProperties: false

examples:
  - |
    #include <dt-bindings/clock/bflb,bl808.h>

    clock-controller@30007000 {
        compatible = "bflb,bl808-mm-clock";
        reg = <0x30007000 0x100>;
        clocks = <&xtal>, <&rc32m>,
                 <&mm_pll BL808_MM_PLL_160M>, <&mm_pll BL808_MM_PLL_240M>;
        clock-names = "xtal", "rc32m", "pll160", "pll240";
        #clock-cells = <1>;
        #reset-cells = <1>;
    };
```

## Documentation/devicetree/bindings/clock/bflb,bl808-mm-spi-clock.yaml
```yaml
# SPDX-License-Identifier: (GPL-2.0-only OR BSD-2-Clause)
%YAML 1.2
---
$id: http://devicetree.org/schemas/clock/bflb,bl808-mm-spi-clock.yaml#
$schema: http://devicetree.org/meta-schemas/core.yaml#

title: Bouffalo Lab BL808 multimedia SPI1 clock and reset

maintainers:
  - Kwanghoon Son <asdfkwang@gmail.com>

description: |
  The SPI1 leaf clock selects multimedia XCLK, divides and gates it.
  The provider uses the firmware-selected crystal XCLK without changing
  the shared clock root. The single reset specifier is zero for SPI1.

properties:
  compatible:
    const: bflb,bl808-mm-spi-clock
  reg:
    maxItems: 1
  clocks:
    maxItems: 1
  clock-names:
    const: xtal
  "#clock-cells":
    const: 0
  "#reset-cells":
    const: 1

required: [compatible, reg, clocks, clock-names, "#clock-cells", "#reset-cells"]
additionalProperties: false
```

## Documentation/devicetree/bindings/dma/bflb,bl808-dma2.yaml
```yaml
# SPDX-License-Identifier: (GPL-2.0-only OR BSD-2-Clause)
%YAML 1.2
---
$id: http://devicetree.org/schemas/dma/bflb,bl808-dma2.yaml#
$schema: http://devicetree.org/meta-schemas/core.yaml#

title: Bouffalo Lab BL808 multimedia DMA2 controller

maintainers:
  - Kwanghoon Son <asdfkwang@gmail.com>

description: |
  DMA2 has eight independent channels and linked descriptors. Each channel has
  a dedicated interrupt. The DMA specifier selects the peripheral request:
  UART3 RX/TX are 0/1, SPI1 RX/TX are 2/3, I2C2 RX/TX are 6/7, I2C3 RX/TX
  are 8/9, DSI RX/TX are 10/11, and DBI TX is 22. Channel allocation is dynamic.

allOf:
  - $ref: dma-controller.yaml#

properties:
  compatible:
    const: bflb,bl808-dma2
  reg:
    maxItems: 1
  interrupts:
    minItems: 8
    maxItems: 8
  clocks:
    maxItems: 1
  clock-names:
    const: bus
  resets:
    maxItems: 1
  '#dma-cells':
    const: 1
  dma-channels:
    const: 8

required:
  - compatible
  - reg
  - interrupts
  - clocks
  - clock-names
  - resets
  - '#dma-cells'

unevaluatedProperties: false

examples:
  - |
    #include <dt-bindings/interrupt-controller/irq.h>

    dma-controller@30001000 {
        compatible = "bflb,bl808-dma2";
        reg = <0x30001000 0x1000>;
        interrupts = <40 IRQ_TYPE_LEVEL_HIGH>, <41 IRQ_TYPE_LEVEL_HIGH>,
                     <42 IRQ_TYPE_LEVEL_HIGH>, <43 IRQ_TYPE_LEVEL_HIGH>,
                     <44 IRQ_TYPE_LEVEL_HIGH>, <45 IRQ_TYPE_LEVEL_HIGH>,
                     <46 IRQ_TYPE_LEVEL_HIGH>, <47 IRQ_TYPE_LEVEL_HIGH>;
        clocks = <&mm_clk 1>;
        clock-names = "bus";
        resets = <&mm_clk 1>;
        #dma-cells = <1>;
        dma-channels = <8>;
    };
```

## Documentation/devicetree/bindings/interrupt-controller/bflb,bl808-mcu-intc.yaml
```yaml
# SPDX-License-Identifier: (GPL-2.0-only OR BSD-2-Clause)
%YAML 1.2
---
$id: http://devicetree.org/schemas/interrupt-controller/bflb,bl808-mcu-intc.yaml#
$schema: http://devicetree.org/meta-schemas/core.yaml#

title: Bouffalo Lab BL808 MCU interrupt forwarding controller

description: |
  Two banks of 32 MCU peripheral interrupt forwarding latches, masks and
  write-one-to-clear registers. Both banks feed D0 PLIC source 81. UART2
  uses input 30.

maintainers:
  - Kwanghoon Son <asdfkwang@gmail.com>

properties:
  compatible:
    const: bflb,bl808-mcu-intc

  reg:
    maxItems: 1

  interrupts:
    maxItems: 1

  interrupt-controller: true

  "#address-cells":
    const: 0

  "#interrupt-cells":
    const: 2
    description: MCU source index followed by IRQ_TYPE_LEVEL_HIGH.

required:
  - compatible
  - reg
  - interrupts
  - interrupt-controller
  - "#address-cells"
  - "#interrupt-cells"

additionalProperties: false

examples:
  - |
    #include <dt-bindings/interrupt-controller/irq.h>
    interrupt-controller@20000050 {
        compatible = "bflb,bl808-mcu-intc";
        reg = <0x20000050 0x18>;
        interrupts = <81 IRQ_TYPE_LEVEL_HIGH>;
        interrupt-controller;
        #address-cells = <0>;
        #interrupt-cells = <2>;
    };
```

## Documentation/devicetree/bindings/mfd/bflb,bl808-glb.yaml
```yaml
# SPDX-License-Identifier: (GPL-2.0-only OR BSD-2-Clause)
%YAML 1.2
---
$id: http://devicetree.org/schemas/mfd/bflb,bl808-glb.yaml#
$schema: http://devicetree.org/meta-schemas/core.yaml#

title: Bouffalo Lab BL808 global register syscon

maintainers:
  - Kwanghoon Son <asdfkwang@gmail.com>

properties:
  compatible:
    items:
      - const: bflb,bl808-glb
      - const: syscon
  reg:
    maxItems: 1

required: [compatible, reg]
additionalProperties: false
```

## Documentation/devicetree/bindings/pinctrl/bflb,bl808-pinctrl.yaml
```yaml
# SPDX-License-Identifier: (GPL-2.0-only OR BSD-2-Clause)
%YAML 1.2
---
$id: http://devicetree.org/schemas/pinctrl/bflb,bl808-pinctrl.yaml#
$schema: http://devicetree.org/meta-schemas/core.yaml#

title: Bouffalo Lab BL808 pin controller and GPIO

maintainers:
  - Kwanghoon Son <asdfkwang@gmail.com>

properties:
  compatible:
    const: bflb,bl808-pinctrl
  reg:
    maxItems: 1
  gpio-controller: true
  "#gpio-cells":
    const: 2

patternProperties:
  "-pins$":
    type: object
    allOf:
      - $ref: pincfg-node.yaml#
      - $ref: pinmux-node.yaml#
    properties:
      pins:
        items:
          pattern: '^GPIO([0-9]|[1-3][0-9]|4[0-5])$'
      function:
        enum: [gpio, spi1]
      bias-disable: true
      bias-pull-up: true
      bias-pull-down: true
      input-enable: true
      input-schmitt-enable: true
      bflb,drive-strength:
        $ref: /schemas/types.yaml#/definitions/uint32
        description: Raw pad drive encoding, from weakest (0) to strongest (3).
        maximum: 3
    required: [pins, function]
    additionalProperties: false

required: [compatible, reg, gpio-controller, "#gpio-cells"]
additionalProperties: false
```

## Documentation/devicetree/bindings/pwm/bflb,bl808-pwm.yaml
```yaml
# SPDX-License-Identifier: GPL-2.0-only OR BSD-2-Clause
%YAML 1.2
---
$id: http://devicetree.org/schemas/pwm/bflb,bl808-pwm.yaml#
$schema: http://devicetree.org/meta-schemas/core.yaml#

title: Bouffalo Lab BL808 PWM controller

maintainers:
  - Kwanghoon Son <asdfkwang@gmail.com>

description:
  The PWM block of the Bouffalo Lab BL808 provides two independent
  four-channel controllers. Each controller counts a 16-bit period divided
  from its input clock through a 16-bit divider, and each channel gates its
  output with a high/low threshold window of that counter. The reference
  manual calls the controllers PWM 0 and PWM 1, and their register groups
  pwm_mc0 and pwm_mc1.

allOf:
  - $ref: pwm.yaml#

properties:
  compatible:
    const: bflb,bl808-pwm

  reg:
    description: The PWM block registers, starting at pwm_int_config.
    maxItems: 1

  clocks:
    description:
      The module input clock. The manual selects it as "xclk", the counter
      clock source reset choice.
    maxItems: 1

  "#pwm-cells":
    const: 3

required:
  - compatible
  - reg
  - clocks
  - "#pwm-cells"

unevaluatedProperties: false

examples:
  - |
    pwm@2000a400 {
        compatible = "bflb,bl808-pwm";
        reg = <0x2000a400 0x100>;
        clocks = <&xtal>;
        #pwm-cells = <3>;
    };
```

## Documentation/devicetree/bindings/serial/bflb,uart.yaml
```yaml
# SPDX-License-Identifier: (GPL-2.0-only OR BSD-2-Clause)
# Copyright (C) 2022 Jisheng Zhang <jszhang@kernel.org>
%YAML 1.2
---
$id: http://devicetree.org/schemas/serial/bflb,uart.yaml#
$schema: http://devicetree.org/meta-schemas/core.yaml#

title: Bouffalo Lab UART Controller

description: |
  UART IP used by Bouffalo Lab SoCs. Initial Linux support covers the
  BL808 controller with a 32-byte FIFO. The compatible follows Zephyr.

maintainers:
  - Kwanghoon Son <asdfkwang@gmail.com>

allOf:
  - $ref: serial.yaml#

properties:
  compatible:
    const: bflb,uart

  reg:
    maxItems: 1

  interrupts:
    maxItems: 1

  clocks:
    items:
      - description: APB register interface clock
      - description: Baud rate generator clock

  clock-names:
    items:
      - const: apb
      - const: baud

  dmas:
    minItems: 1
    items:
      - description: Receive DMA channel
      - description: Transmit DMA channel

  dma-names:
    minItems: 1
    items:
      - const: rx
      - const: tx

  resets:
    maxItems: 1

required:
  - compatible
  - reg
  - interrupts
  - clocks
  - clock-names

dependentRequired:
  dmas: [dma-names]
  dma-names: [dmas]

unevaluatedProperties: false

examples:
  - |
    #include <dt-bindings/interrupt-controller/irq.h>

    uart3: serial@30002000 {
        compatible = "bflb,uart";
        reg = <0x30002000 0x1000>;
        interrupts = <20 IRQ_TYPE_LEVEL_HIGH>;
        clocks = <&uart_apb>, <&uart_baud>;
        clock-names = "apb", "baud";
    };
...
```

## Documentation/devicetree/bindings/serial/bouffalolab,bl808-uart.yaml
```yaml
# SPDX-License-Identifier: (GPL-2.0-only OR BSD-2-Clause)
%YAML 1.2
---
$id: http://devicetree.org/schemas/serial/bouffalolab,bl808-uart.yaml#
$schema: http://devicetree.org/meta-schemas/core.yaml#

title: Bouffalo Lab UART Controller

description: |
  The Bouffalo Lab BL808 UART controller has a 32-byte FIFO, an APB
  register interface and a separate baud rate generator clock.

maintainers:
  - Kwanghoon Son <asdfkwang@gmail.com>

allOf:
  - $ref: serial.yaml#

properties:
  compatible:
    const: bouffalolab,bl808-uart

  reg:
    maxItems: 1

  interrupts:
    maxItems: 1

  clocks:
    items:
      - description: APB register interface clock
      - description: Baud rate generator clock

  clock-names:
    items:
      - const: apb
      - const: baud

  resets:
    maxItems: 1
    description: UART peripheral reset

required:
  - compatible
  - reg
  - interrupts
  - clocks
  - clock-names

unevaluatedProperties: false

examples:
  - |
    #include <dt-bindings/interrupt-controller/irq.h>

    serial@30002000 {
        compatible = "bouffalolab,bl808-uart";
        reg = <0x30002000 0x1000>;
        interrupts = <20 IRQ_TYPE_LEVEL_HIGH>;
        clocks = <&uart_apb>, <&uart_baud>;
        clock-names = "apb", "baud";
    };
...
```

## Documentation/devicetree/bindings/spi/bflb,bl808-spi.yaml
```yaml
# SPDX-License-Identifier: (GPL-2.0-only OR BSD-2-Clause)
%YAML 1.2
---
$id: http://devicetree.org/schemas/spi/bflb,bl808-spi.yaml#
$schema: http://devicetree.org/meta-schemas/core.yaml#

title: Bouffalo Lab BL808 SPI controller

maintainers:
  - Kwanghoon Son <asdfkwang@gmail.com>

allOf:
  - $ref: spi-controller.yaml#

properties:
  compatible:
    const: bflb,bl808-spi
  reg:
    maxItems: 1
  interrupts:
    maxItems: 1
  clocks:
    maxItems: 1
  resets:
    maxItems: 1
  bflb,glb:
    $ref: /schemas/types.yaml#/definitions/phandle
    description: Global register syscon containing the SPI master-mode selection.

required: [compatible, reg, interrupts, clocks, resets, bflb,glb]
unevaluatedProperties: false
```
